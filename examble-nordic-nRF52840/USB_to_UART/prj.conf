## CMakeLists.txt
```
#
# Copyright (c) 2020 Nordic Semiconductor
#
# SPDX-License-Identifier: LicenseRef-Nordic-5-Clause
#

cmake_minimum_required(VERSION 3.20.0)

find_package(Zephyr REQUIRED HINTS $ENV{ZEPHYR_BASE})
project(low_power_uart)

FILE(GLOB app_sources src/*.c)

# include uart_communication.h
zephyr_include_directories(src/UartCommunication)

#include led_blink.h
zephyr_include_directories(src/LEDblink)

# include uart_communication.c
target_sources(app PRIVATE src/UartCommunication/uart_communication.c)

#include led_blink
target_sources(app PRIVATE src/LEDblink/led_blink.c)

# NORDIC SDK APP START
target_sources(app PRIVATE
	${app_sources}
)
# NORDIC SDK APP END
```

## prj.conf
```kconfig
#
# Copyright (c) 2020 Nordic Semiconductor
#
# SPDX-License-Identifier: LicenseRef-Nordic-5-Clause
#

# CONFIG_USE_SEGGER_RTT=n
# CONFIG_LOG=y
# CONFIG_NO_OPTIMIZATIONS=y
# CONFIG_ASSERT=y

# Comment this section for debugging
# CONFIG_CONSOLE=y
# CONFIG_UART_CONSOLE=y

# USB
CONFIG_USB_DEVICE_STACK=y
CONFIG_USB_DEVICE_MANUFACTURER="Nordic Semiconductor"
CONFIG_USB_DEVICE_PRODUCT="nRF52840DK"
CONFIG_USB_COMPOSITE_DEVICE=y
CONFIG_USB_CDC_ACM=y
CONFIG_USB_CDC_ACM_RINGBUF_SIZE=4096

# Logging
CONFIG_LOG=y
CONFIG_USE_SEGGER_RTT=y
CONFIG_LOG_BACKEND_RTT=y
CONFIG_LOG_BACKEND_RTT_MODE_DROP=y

 # UART
CONFIG_SERIAL=y
CONFIG_UART_INTERRUPT_DRIVEN=y
CONFIG_UART_LINE_CTRL=y
CONFIG_UART_1_NRF_TX_BUFFER_SIZE=8192
CONFIG_UART_0_NRF_TX_BUFFER_SIZE=8192

# LED GPIO
CONFIG_GPIO=y

# Heap and stacks
CONFIG_HEAP_MEM_POOL_SIZE=81920
CONFIG_MAIN_STACK_SIZE=40960
CONFIG_SYSTEM_WORKQUEUE_STACK_SIZE=4096

#General
CONFIG_REBOOT=y
CONFIG_POLL=y
CONFIG_BOOTLOADER_MCUBOOT=y
```

## app.overlay
```dts
/*
 * Copyright (c) 2021 Nordic Semiconductor ASA
 *
 * SPDX-License-Identifier: Apache-2.0
 */
 
/ {
	chosen {
		zephyr,console = &cdc_acm_uart0;
	};
};

&zephyr_udc0 {
	cdc_acm_uart0: cdc_acm_uart0 {
		compatible = "zephyr,cdc-acm-uart";
		label = "CDC_ACM_0";
	};
};
```

## src/main.c
```c
/*
 * Copyright (c) 2020 Nordic Semiconductor ASA
 *
 * SPDX-License-Identifier: LicenseRef-Nordic-5-Clause
 */

#include <zephyr.h>
#include <uart_communication.h>
#include <led_blink.h>
#include <logging/log.h>

LOG_MODULE_REGISTER(app);

void main(void)
{
    printk("Sensor Test Start!\n");
    
    init_led();

    start_timer();
   
    usb_2_uart_init();

    while(1)
    {

    }
}
```
