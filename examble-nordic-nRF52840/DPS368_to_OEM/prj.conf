## CMakeLists.txt
```
# SPDX-License-Identifier: Apache-2.0

cmake_minimum_required(VERSION 3.20.0)
find_package(Zephyr REQUIRED HINTS $ENV{ZEPHYR_BASE})

project(dps310)
FILE(GLOB app_sources src/*.c)

# include uart_communication
zephyr_include_directories(src/UartCommunication)
target_sources(app PRIVATE src/UartCommunication/uart_communication.c)

# include dps368 scheduling
zephyr_include_directories(src/Scheduling)
target_sources(app PRIVATE src/Scheduling/scheduling.c)

#include Tributech lib
zephyr_include_directories(src/TributechLib)
target_sources(app PRIVATE src/TributechLib/tributech_oem_api.c)

#include jsmn json parser
zephyr_include_directories(src/JSMNParser)
target_sources(app PRIVATE src/JSMNParser/jsmn.c)

# include BASE64
zephyr_include_directories(src/BASE64)
target_sources(app PRIVATE src/BASE64/BASE64.c)

target_sources(app PRIVATE ${app_sources})
```

## sample.yaml
```
sample:
  name: DP368  Sensor sample
tests:
  sample.sensor.dps310:
    harness: console
    tags: sensors
    depends_on: i2c arduino_i2c
    harness_config:
        type: one_line
        regex:
            - "temp: (.*); press: (.*);"
        fixture: fixture_i2c_dps368
```

## prj.conf
```kconfig
CONFIG_STDOUT_CONSOLE=y

# Heap and stacks
CONFIG_HEAP_MEM_POOL_SIZE=32768
CONFIG_MAIN_STACK_SIZE=32768   
# 16384
CONFIG_SYSTEM_WORKQUEUE_STACK_SIZE=8192

CONFIG_LOG=y
CONFIG_LOG_STRDUP_MAX_STRING=64
CONFIG_LOG_MODE_IMMEDIATE=y

# CONFIG_DEBUG_OPTIMIZATIONS=y
CONFIG_NEWLIB_LIBC=y
CONFIG_NEWLIB_LIBC_FLOAT_PRINTF=y
CONFIG_CBPRINTF_FP_SUPPORT=y
CONFIG_NEWLIB_LIBC_NANO=n
CONFIG_I2C=y

# Uart Config
CONFIG_NRFX_UARTE0=y
CONFIG_UART_ASYNC_API=y

# Debugging
CONFIG_DEBUG_OPTIMIZATIONS=y
```

## src/main.c
```c
/*
 * main.c
 *
 *  Created on: 2022 Jun 21 11:10:10
 *  Author: AndreasAscher
 */

#include <zephyr.h>
#include <kernel.h>
#include <device.h>

#include <drivers/sensor.h>
#include <stdlib.h>
#include <stdio.h>
#include <uart_communication.h>
// #include <dps368.h>
#include <scheduling.h>
// #include <Base64.h>
#include <logging/log.h>
// #include <tributech_oem_api.h>


LOG_MODULE_REGISTER(app, LOG_LEVEL_INF);

// char valuemetadataid_temperature[37] = "09002d61-b0f4-4971-8034-500b1775eeab";
// char valuemetadataid_pressure[37] = "7d5a71d3-c384-4778-a66b-87f3c15a8795";
int oem_info_gathering_status = 0;

// char base64_string_temperature[20] = "";
// char base64_string_pressure[20] = "";
char provide_value_message_temperature[500] = "{\"TransactionNr\": 1, \"Operation\": \"ProvideValue\",\"ValueMetadataId\": \"09002d61-b0f4-4971-8034-500b1775eeab\", \"Timestamp\": 0, \"Value\": \"AADIQQ==\"}\r\n";
char provide_value_message_pressure[500] = "{\"TransactionNr\": 2, \"Operation\": \"ProvideValue\",\"ValueMetadataId\": \"7d5a71d3-c384-4778-a66b-87f3c15a8795\", \"Timestamp\": 0, \"Value\": \"AIy5Rw==\"}\r\n";
uint8_t return_code = 0;
uint64_t cycle_counter = 0;

// timer definitions
struct k_timer dps368_timer;

// +++++++++++++++++++++++++++++++++++++++++++++++++++++
// Dps368 timer capture handler
static void dps368_timer_handler(struct k_timer *dummy)
{
    if((cycle_counter % 2) == 0)
    {
        uart_tx(uart, provide_value_message_temperature, strlen(provide_value_message_temperature) + 1, 500);
    }
    else
    {
        uart_tx(uart, provide_value_message_pressure, strlen(provide_value_message_pressure) + 1, 500);
    }
    cycle_counter++;
}

void main(void)
{
    LOG_INF("Hello DPS368\n");
    uart_init();

    // This k_sleep is needed to allow the Tributech OEM module to initialize 
    k_sleep(K_MSEC(60000));

    // Start dps368 function with a 2 minute periode
    k_timer_start(&dps368_timer, K_SECONDS(30), K_SECONDS(30));

    while (1) 
    {

    }
}

K_TIMER_DEFINE(dps368_timer, dps368_timer_handler, NULL);
```
